## devices/common/mcu/matter/Kconfig.common
```kconfig
#
# Copyright (c) 2026 txing contributors
#
# SPDX-License-Identifier: Apache-2.0
#

config TXING_MATTER_AVERAGE_CURRENT_CONSUMPTION_UA
	int "Average Matter device current consumption in microamperes"
	range 1 2147483647
	default 1000
	help
	  Predicted average current consumption used to estimate the remaining
	  Power Source battery time.

if OPENTHREAD

choice OPENTHREAD_NORDIC_LIBRARY_CONFIGURATION
	default OPENTHREAD_NORDIC_LIBRARY_MTD
endchoice

choice OPENTHREAD_DEVICE_TYPE
	default OPENTHREAD_MTD
endchoice

config IEEE802154_NRF5_RX_STACK_SIZE
	default 8192

config CHIP_ENABLE_ICD_SUPPORT
	default y

endif # OPENTHREAD
```

## devices/common/mcu/matter/Kconfig.sysbuild.common
```kconfig
#
# Copyright (c) 2026 txing contributors
#
# SPDX-License-Identifier: Apache-2.0
#

config DFU_MULTI_IMAGE_PACKAGE_BUILD
	default y

config DFU_MULTI_IMAGE_PACKAGE_APP
	default y

choice BOOTLOADER
	default BOOTLOADER_MCUBOOT
endchoice

choice MCUBOOT_MODE
	default MCUBOOT_MODE_OVERWRITE_ONLY
endchoice

choice BOOT_SIGNATURE_TYPE
	default BOOT_SIGNATURE_TYPE_RSA
endchoice

source "share/sysbuild/Kconfig"
```

## devices/power/mcu/zephyr/Kconfig
```kconfig
# SPDX-License-Identifier: Apache-2.0

mainmenu "txing power MCU"

rsource "../../../common/mcu/xiao_nrf54l15/Kconfig"
source "Kconfig.zephyr"
```

## devices/unit/mcu/zephyr/Kconfig
```kconfig
# SPDX-License-Identifier: Apache-2.0

mainmenu "txing unit MCU"

rsource "../../../common/mcu/xiao_nrf54l15/Kconfig"
source "Kconfig.zephyr"
```

## devices/weather/mcu/zephyr/Kconfig
```kconfig
# SPDX-License-Identifier: Apache-2.0

mainmenu "txing weather MCU"

menu "Weather"

config WEATHER_BME280_POWER_SETTLE_MS
	int "BME280 D1 power settle delay in ms"
	range 2 60000
	help
	  Delay after enabling D1 sensor power before the BME280 is accessed.

endmenu

rsource "../../../common/mcu/xiao_nrf54l15/Kconfig"
source "Kconfig.zephyr"
```
