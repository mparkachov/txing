## devices/power-nrf/mcu/zephyr/Kconfig
```kconfig
mainmenu "txing power-nrf MCU"

source "Kconfig.zephyr"

config TXING_POWER_NRF_SED_RECOVERY
	bool "Use exponential SED-only Thread recovery"
	help
	  Retry a lost sleepy Thread attachment with a capped exponential backoff,
	  without returning to receiver-on bootstrap mode.

config TXING_POWER_NRF_RECEIVER_ON_DIAGNOSTICS
	bool "Use receiver-on Thread recovery diagnostics"
	help
	  Keep ordinary debug recovery in receiver-on mode after a lost SED
	  attachment. This diagnostic option is intentionally incompatible with
	  the release and SED-debug exponential SED-only policy.
```

## devices/power-si/mcu/zephyr/Kconfig
```kconfig
mainmenu "txing power-si MCU"

source "Kconfig.zephyr"

config TXING_POWER_SI_OPENTHREAD_SRP_PSA_PUBLIC_KEY
	bool
	default y
	depends on OPENTHREAD_CRYPTO_PSA && OPENTHREAD_SRP_CLIENT
	select PSA_WANT_KEY_TYPE_ECC_PUBLIC_KEY
	help
	  Zephyr's OpenThread PSA config selects the SRP ECDSA key-pair
	  options, but SRP also exports the public key while preparing its DNS
	  Update signature. Enable the matching public-key type for this app.

config TXING_POWER_SI_SRP_PSA_DIAGNOSTICS
	bool "Log SRP PSA key diagnostics"
	depends on OPENTHREAD_CRYPTO_PSA && OPENTHREAD_SRP_CLIENT
	default n
	help
	  Log exact PSA status values for the OpenThread SRP ECDSA key path.
	  This is intended for debug firmware only.

config TXING_POWER_SI_SED_RECOVERY_TEST
	bool "Retry a lost requested-link attachment"
	depends on OPENTHREAD_MTD_SED
	default n
	help
	  Recovery policy for the validated SED profiles. After the SRP bootstrap
	  transitions the child to SED mode, retry a persistent lost attachment with
	  the requested link mode. Without the optional REDCON link-mode policy this
	  is SED only. The retry count and delays are intentionally bounded.

config TXING_POWER_SI_SED_REDCON_LINK_MODE_TEST
	bool "Use REDCON to switch requested Thread link mode"
	depends on TXING_POWER_SI_SED_RECOVERY_TEST
	default n
	help
	  Active-power policy shared by the final release and SED debug image. REDCON
	  3 keeps the MTD receiver on when idle (`rn`) so follow-up commands are
	  immediate. REDCON 4 returns to the normal sleepy (`n`) posture. The
	  transition is a live link-mode update and retains the existing Thread child
	  and SRP service.

config TXING_POWER_SI_PM_TRANSITION_DIAGNOSTICS
	bool "Log Silicon Labs EM1/EM2 sleep-mode changes"
	depends on PM && SOC_FAMILY_SILABS_S2
	default n
	help
	  Subscribe to Silicon Labs power-manager transition events and log the
	  initial EM1/EM2 sleep-mode selection plus changes between those modes.
	  Routine wake transitions through EM0 are intentionally omitted. This is a
	  focused sed-debug diagnostic and should not be enabled in release or
	  ordinary debug firmware.

config TXING_POWER_SI_BATTERY_REPORTING
	bool "Report XIAO MG24 battery voltage"
	depends on ADC && PM_DEVICE
	default n
	help
	  Sample the XIAO MG24 battery divider on demand for CoAP state responses.
	  The board's active-high PD3 divider enable is asserted only while PD4 is
	  settling and sampled. The IADC uses its calibrated internal reference at
	  half gain, and the measured divider voltage is multiplied by two. This is
	  enabled by the final release profile.
```

## devices/power-si/mcu/zephyr/dts/bindings/txing-battery-divider.yaml
```yaml
description: GPIO-controlled battery voltage divider

compatible: "txing-battery-divider"

include: base.yaml

properties:
  io-channels:
    type: phandle-array
    required: true

  enable-gpios:
    type: phandle-array
    required: true
```

## devices/tbot/mcu/zephyr/Kconfig
```kconfig
mainmenu "txing tbot MCU"

source "Kconfig.zephyr"

config TXING_TBOT_SED_RECOVERY
	bool "Use bounded SED-only Thread recovery"
	help
	  Retry a lost sleepy Thread attachment at most three times without
	  returning to receiver-on bootstrap mode.

config TXING_TBOT_RECEIVER_ON_DIAGNOSTICS
	bool "Use receiver-on Thread recovery diagnostics"
	help
	  Keep ordinary debug recovery in receiver-on mode after a lost SED
	  attachment. This diagnostic option is intentionally incompatible with
	  the release and SED-debug bounded SED-only policy.
```
