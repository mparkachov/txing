## CMakeLists.txt
```
cmake_minimum_required(VERSION 3.20.0)

find_package(Zephyr REQUIRED HINTS $ENV{ZEPHYR_BASE})
project(txing_weather_bm)

target_sources(app PRIVATE
  src/main.c
  src/weather_bme280.c
  src/weather_protocol.c
)
```

## Kconfig
```
menu "txing weather bare-metal firmware"

config TXING_WEATHER_FACTORY_DATA_ADDR
	hex "Weather factory data flash address"
	default 0x000f0000

config TXING_WEATHER_ADV_INTERVAL_625US
	int "Advertising interval in 625 us units"
	default 160
	help
	  160 is 100 ms.

config TXING_WEATHER_ADV_TX_POWER_DBM
	int "Advertising transmit power in dBm"
	default 8

config TXING_WEATHER_INVALID_NAME
	string "Fallback local name when factory data is invalid"
	default "TxingWeatherInvalid"

module=TXING_WEATHER_BM
module-str=txing weather bare-metal firmware
source "$(ZEPHYR_BASE)/subsys/logging/Kconfig.template.log_config"

endmenu

source "Kconfig.zephyr"
```

## sample.yaml
```
sample:
  name: txing weather bare-metal firmware
  description: S115 connected-idle BLE firmware for txing weather devices.
tests:
  sample.txing.weather_bm:
    platform_allow:
      - bm_nrf54l15dk/nrf54l15/cpuapp/s115_softdevice
    integration_platforms:
      - bm_nrf54l15dk/nrf54l15/cpuapp/s115_softdevice
```

## prj.conf
```kconfig
# Logging
CONFIG_LOG=y
CONFIG_LOG_BACKEND_BM_UARTE=n
CONFIG_USE_SEGGER_RTT=y
CONFIG_LOG_BACKEND_RTT=y
CONFIG_LOG_BACKEND_RTT_MODE_DROP=y
CONFIG_LOG_BACKEND_RTT_MESSAGE_SIZE=256
CONFIG_SEGGER_RTT_BUFFER_SIZE_UP=4096

# SoftDevice S115
CONFIG_SOFTDEVICE=y
CONFIG_NRF_SDH_BLE_VS_UUID_COUNT=1

# SoftDevice BLE initialization uses PSA RNG.
CONFIG_NRF_SECURITY=y
CONFIG_MBEDTLS_PSA_CRYPTO_C=y
CONFIG_PSA_WANT_GENERATE_RANDOM=y

# Advertising data encoder.
CONFIG_BLE_ADV=y

# Grove BME280 over XIAO I2C connector.
CONFIG_NRFX_TWIM=y

CONFIG_TXING_WEATHER_BM_LOG_LEVEL_INF=y
```

## src/main.c
```c
#include "weather_bme280.h"
#include "weather_protocol.h"

#include <ble.h>
#include <ble_gatt.h>
#include <ble_gap.h>
#include <bm/bluetooth/ble_adv_data.h>
#include <bm/softdevice_handler/nrf_sdh.h>
#include <bm/softdevice_handler/nrf_sdh_ble.h>
#include <hal/nrf_gpio.h>
#include <nrf_error.h>

#include <zephyr/kernel.h>
#include <zephyr/logging/log.h>
#include <zephyr/logging/log_ctrl.h>

#include <stdbool.h>
#include <stddef.h>
#include <stdint.h>
#include <string.h>

LOG_MODULE_REGISTER(txing_weather_bm, CONFIG_TXING_WEATHER_BM_LOG_LEVEL);

#define FACTORY_MAGIC 0x31575854u
#define FACTORY_VERSION 1u
#define FACTORY_THING_NAME_SIZE 26u
#define ADV_DATA_SIZE BLE_GAP_ADV_SET_DATA_SIZE_MAX

#define WEATHER_UUID_BASE                                                                      \
	{                                                                                      \
		0x00, 0xf1, 0xb8, 0xa2, 0xf0, 0x4f, 0x4b, 0x9f, 0x2d, 0x4d, 0x32, 0x7b,    \
			0x00, 0x00, 0xb4, 0xf6                                           \
	}
#define WEATHER_UUID_SERVICE 0xb000u
#define WEATHER_UUID_COMMAND 0xb001u
#define WEATHER_UUID_STATE 0xb002u
#define WEATHER_UUID_MEASUREMENT 0xb003u

#define XIAO_LED_PIN NRF_PIN_PORT_TO_PIN_NUMBER(0, 2)
#define XIAO_LED_ACTIVE_STATE 0u

#define WEATHER_SAMPLE_INTERVAL_MS 1000u
#define WEATHER_DIAG_INTERVAL_MS 10000u
#define WEATHER_IDLE_CONN_PARAM_FALLBACK_DELAY_MS 30000u

#define WEATHER_IDLE_CONN_INTERVAL_1000_MS 800u
#define WEATHER_IDLE_CONN_LATENCY 4u
#define WEATHER_IDLE_CONN_SUPERVISION_12S 1200u

struct weather_factory_data {
	uint32_t magic;
	uint8_t version;
	uint8_t thing_name_len;
	char thing_name[FACTORY_THING_NAME_SIZE];
	uint32_t crc32;
};

_Static_assert(sizeof(struct weather_factory_data) == 36, "factory data layout changed");

static uint8_t g_adv_handle = BLE_GAP_ADV_SET_HANDLE_NOT_SET;
static uint8_t g_adv_data_buf[ADV_DATA_SIZE];
static uint8_t g_scan_rsp_buf[ADV_DATA_SIZE];
static ble_gap_adv_data_t g_gap_adv_data;
static ble_gap_adv_params_t g_adv_params;

static uint16_t g_conn_handle = BLE_CONN_HANDLE_INVALID;
static uint8_t g_weather_uuid_type = BLE_UUID_TYPE_UNKNOWN;
static uint16_t g_weather_service_handle;
static ble_gatts_char_handles_t g_command_handles;
static ble_gatts_char_handles_t g_state_handles;
static ble_gatts_char_handles_t g_measurement_handles;

static struct weather_state g_state = {
	.redcon = WEATHER_REDCON_IDLE,
	.bme280_valid = false,
	.battery_mv = 0u,
};
static struct weather_measurement g_measurement;
static bool g_measurement_valid;
static bool g_idle_conn_params_requested;
static bool g_state_notify_enabled;
static bool g_measurement_notify_enabled;
static int64_t g_connected_at_ms;

static uint32_t crc32(const uint8_t *data, size_t size)
{
	uint32_t crc = 0xffffffffu;

	for (size_t i = 0; i < size; ++i) {
		crc ^= data[i];
		for (int bit = 0; bit < 8; ++bit) {
			const bool lsb = (crc & 1u) != 0u;

			crc >>= 1u;
			if (lsb) {
				crc ^= 0xedb88320u;
			}
		}
	}

	return crc ^ 0xffffffffu;
}

static bool read_factory_name(char *name, size_t name_size)
{
	const struct weather_factory_data *stored =
		(const struct weather_factory_data *)CONFIG_TXING_WEATHER_FACTORY_DATA_ADDR;
	const uint8_t *bytes = (const uint8_t *)stored;
	const size_t crc_len = sizeof(*stored) - sizeof(stored->crc32);

	if (name_size <= FACTORY_THING_NAME_SIZE) {
		return false;
	}
	if (stored->magic != FACTORY_MAGIC || stored->version != FACTORY_VERSION) {
		return false;
	}
	if (stored->thing_name_len == 0u || stored->thing_name_len > FACTORY_THING_NAME_SIZE) {
		return false;
	}
	if (crc32(bytes, crc_len) != stored->crc32) {
		return false;
	}

	for (uint8_t i = 0; i < stored->thing_name_len; ++i) {
		const char ch = stored->thing_name[i];

		if (ch < '!' || ch > '~') {
			return false;
		}
		name[i] = ch;
	}
	name[stored->thing_name_len] = '\0';
	return true;
}

static void led_set(bool on)
{
	nrf_gpio_pin_write(XIAO_LED_PIN, on ? XIAO_LED_ACTIVE_STATE : !XIAO_LED_ACTIVE_STATE);
}

static void led_init(void)
{
	nrf_gpio_cfg_output(XIAO_LED_PIN);
	led_set(false);
}

static uint32_t set_gap_device_name(const char *name)
{
	ble_gap_conn_sec_mode_t write_sec;

	BLE_GAP_CONN_SEC_MODE_SET_NO_ACCESS(&write_sec);
	return sd_ble_gap_device_name_set(&write_sec, name, strlen(name));
}

static uint32_t add_weather_characteristic(uint16_t uuid, bool can_read, bool can_write,
					   bool can_notify, const uint8_t *initial_value,
					   uint16_t initial_len, uint16_t max_len,
					   ble_gatts_char_handles_t *handles)
{
	ble_uuid_t char_uuid = {
		.type = g_weather_uuid_type,
		.uuid = uuid,
	};
	ble_gatts_char_md_t char_md = {0};
	ble_gatts_attr_md_t cccd_md = {0};
	ble_gatts_attr_md_t attr_md = {0};
	ble_gatts_attr_t attr = {0};

	char_md.char_props.read = can_read;
	char_md.char_props.write = can_write;
	char_md.char_props.notify = can_notify;

	if (can_notify) {
		BLE_GAP_CONN_SEC_MODE_SET_OPEN(&cccd_md.read_perm);
		BLE_GAP_CONN_SEC_MODE_SET_OPEN(&cccd_md.write_perm);
		cccd_md.vloc = BLE_GATTS_VLOC_STACK;
		char_md.p_cccd_md = &cccd_md;
	}

	if (can_read) {
		BLE_GAP_CONN_SEC_MODE_SET_OPEN(&attr_md.read_perm);
	} else {
		BLE_GAP_CONN_SEC_MODE_SET_NO_ACCESS(&attr_md.read_perm);
	}
	if (can_write) {
		BLE_GAP_CONN_SEC_MODE_SET_OPEN(&attr_md.write_perm);
	} else {
		BLE_GAP_CONN_SEC_MODE_SET_NO_ACCESS(&attr_md.write_perm);
	}
	attr_md.vloc = BLE_GATTS_VLOC_STACK;

	attr.p_uuid = &char_uuid;
	attr.p_attr_md = &attr_md;
	attr.p_value = (uint8_t *)initial_value;
	attr.init_len = initial_len;
	attr.max_len = max_len;

	return sd_ble_gatts_characteristic_add(g_weather_service_handle, &char_md, &attr,
					       handles);
}

static void encode_current_state(uint8_t payload[WEATHER_STATE_PAYLOAD_SIZE])
{
	weather_encode_state(&g_state, payload);
}

static uint32_t update_gatt_value(uint16_t value_handle, uint8_t *payload, uint16_t len)
{
	ble_gatts_value_t value = {
		.len = len,
		.p_value = payload,
	};

	return sd_ble_gatts_value_set(g_conn_handle, value_handle, &value);
}

static void notify_value(uint16_t value_handle, uint8_t *payload, uint16_t len)
{
	uint32_t nrf_err;
	ble_gatts_hvx_params_t hvx = {
		.handle = value_handle,
		.type = BLE_GATT_HVX_NOTIFICATION,
		.p_len = &len,
		.p_data = payload,
	};

	if (g_conn_handle == BLE_CONN_HANDLE_INVALID) {
		return;
	}

	nrf_err = sd_ble_gatts_hvx(g_conn_handle, &hvx);
	if (nrf_err != NRF_SUCCESS && nrf_err != NRF_ERROR_INVALID_STATE &&
	    nrf_err != NRF_ERROR_RESOURCES && nrf_err != NRF_ERROR_BUSY) {
		LOG_DBG("Failed to notify handle=%u, nrf_error %#x", value_handle, nrf_err);
	}
}

static void publish_state(bool notify)
{
	uint8_t payload[WEATHER_STATE_PAYLOAD_SIZE];
	uint32_t nrf_err;

	encode_current_state(payload);
	nrf_err = update_gatt_value(g_state_handles.value_handle, payload, sizeof(payload));
	if (nrf_err != NRF_SUCCESS) {
		LOG_DBG("Failed to update state value, nrf_error %#x", nrf_err);
	}
	if (notify) {
		notify_value(g_state_handles.value_handle, payload, sizeof(payload));
	}
}

static void publish_measurement(bool notify)
{
	uint8_t payload[WEATHER_MEASUREMENT_PAYLOAD_SIZE];
	uint32_t nrf_err;

	if (!g_measurement_valid) {
		return;
	}

	weather_encode_measurement(&g_measurement, payload);
	nrf_err = update_gatt_value(g_measurement_handles.value_handle, payload, sizeof(payload));
	if (nrf_err != NRF_SUCCESS) {
		LOG_DBG("Failed to update measurement value, nrf_error %#x", nrf_err);
	}
	if (notify) {
		notify_value(g_measurement_handles.value_handle, payload, sizeof(payload));
	}
}

static uint32_t weather_service_init(void)
{
	uint32_t nrf_err;
	ble_uuid128_t base_uuid = {
		.uuid128 = WEATHER_UUID_BASE,
	};
	ble_uuid_t service_uuid;
	uint8_t command_init[WEATHER_COMMAND_PAYLOAD_SIZE] = { WEATHER_PROTOCOL_VERSION,
							       WEATHER_REDCON_IDLE };
	uint8_t state_init[WEATHER_STATE_PAYLOAD_SIZE];
	uint8_t measurement_init[WEATHER_MEASUREMENT_PAYLOAD_SIZE] = {0};

	nrf_err = sd_ble_uuid_vs_add(&base_uuid, &g_weather_uuid_type);
	if (nrf_err != NRF_SUCCESS) {
		return nrf_err;
	}

	service_uuid.type = g_weather_uuid_type;
	service_uuid.uuid = WEATHER_UUID_SERVICE;
	nrf_err = sd_ble_gatts_service_add(BLE_GATTS_SRVC_TYPE_PRIMARY, &service_uuid,
					   &g_weather_service_handle);
	if (nrf_err != NRF_SUCCESS) {
		return nrf_err;
	}

	nrf_err = add_weather_characteristic(WEATHER_UUID_COMMAND, false, true, false,
					     command_init, sizeof(command_init),
					     sizeof(command_init), &g_command_handles);
	if (nrf_err != NRF_SUCCESS) {
		return nrf_err;
	}

	encode_current_state(state_init);
	nrf_err = add_weather_characteristic(WEATHER_UUID_STATE, true, false, true, state_init,
					     sizeof(state_init), sizeof(state_init),
					     &g_state_handles);
	if (nrf_err != NRF_SUCCESS) {
		return nrf_err;
	}

	nrf_err = add_weather_characteristic(WEATHER_UUID_MEASUREMENT, true, false, true,
					     measurement_init, sizeof(measurement_init),
					     sizeof(measurement_init), &g_measurement_handles);
	if (nrf_err != NRF_SUCCESS) {
		return nrf_err;
	}

	return NRF_SUCCESS;
}

static uint32_t start_advertising(void)
{
	uint32_t nrf_err;
	uint16_t adv_len = sizeof(g_adv_data_buf);
	uint16_t scan_rsp_len = sizeof(g_scan_rsp_buf);
	ble_uuid_t service_uuid = {
		.type = g_weather_uuid_type,
		.uuid = WEATHER_UUID_SERVICE,
	};
	struct ble_adv_data adv_data = {
		.name_type = BLE_ADV_DATA_FULL_NAME,
		.flags = BLE_GAP_ADV_FLAGS_LE_ONLY_GENERAL_DISC_MODE,
	};
	struct ble_adv_data scan_rsp = {
		.uuid_lists.complete.uuid = &service_uuid,
		.uuid_lists.complete.len = 1u,
	};

	nrf_err = ble_adv_data_encode(&adv_data, g_adv_data_buf, &adv_len);
	if (nrf_err != NRF_SUCCESS) {
		return nrf_err;
	}
	LOG_HEXDUMP_INF(g_adv_data_buf, adv_len, "Encoded advertising data");

	nrf_err = ble_adv_data_encode(&scan_rsp, g_scan_rsp_buf, &scan_rsp_len);
	if (nrf_err != NRF_SUCCESS) {
		return nrf_err;
	}
	LOG_HEXDUMP_INF(g_scan_rsp_buf, scan_rsp_len, "Encoded scan response data");

	memset(&g_gap_adv_data, 0, sizeof(g_gap_adv_data));
	g_gap_adv_data.adv_data.p_data = g_adv_data_buf;
	g_gap_adv_data.adv_data.len = adv_len;
	g_gap_adv_data.scan_rsp_data.p_data = g_scan_rsp_buf;
	g_gap_adv_data.scan_rsp_data.len = scan_rsp_len;

	memset(&g_adv_params, 0, sizeof(g_adv_params));
	g_adv_params.properties.type = BLE_GAP_ADV_TYPE_CONNECTABLE_SCANNABLE_UNDIRECTED;
	g_adv_params.interval = CONFIG_TXING_WEATHER_ADV_INTERVAL_625US;
	g_adv_params.duration = 0;
	g_adv_params.filter_policy = BLE_GAP_ADV_FP_ANY;
	g_adv_params.scan_req_notification = 1;

	nrf_err = sd_ble_gap_adv_set_configure(&g_adv_handle, &g_gap_adv_data, &g_adv_params);
	if (nrf_err != NRF_SUCCESS) {
		return nrf_err;
	}

	nrf_err = sd_ble_gap_tx_power_set(BLE_GAP_TX_POWER_ROLE_ADV, g_adv_handle,
					  CONFIG_TXING_WEATHER_ADV_TX_POWER_DBM);
	if (nrf_err != NRF_SUCCESS) {
		LOG_WRN("Failed to set advertising TX power %d dBm, nrf_error %#x",
			CONFIG_TXING_WEATHER_ADV_TX_POWER_DBM, nrf_err);
	}

	return sd_ble_gap_adv_start(g_adv_handle, CONFIG_NRF_SDH_BLE_CONN_TAG);
}

static bool request_connected_idle_params(uint16_t conn_handle)
{
	ble_gap_conn_params_t params = {
		.min_conn_interval = WEATHER_IDLE_CONN_INTERVAL_1000_MS,
		.max_conn_interval = WEATHER_IDLE_CONN_INTERVAL_1000_MS,
		.slave_latency = WEATHER_IDLE_CONN_LATENCY,
		.conn_sup_timeout = WEATHER_IDLE_CONN_SUPERVISION_12S,
	};
	uint32_t nrf_err = sd_ble_gap_conn_param_update(conn_handle, &params);

	if (nrf_err != NRF_SUCCESS) {
		LOG_DBG("Failed to request connection params, nrf_error %#x", nrf_err);
		return false;
	}
	LOG_INF("Requested connected-idle params interval=1000ms latency=%u supervision=12s",
		WEATHER_IDLE_CONN_LATENCY);
	return true;
}

static void request_idle_params_if_ready(void)
{
	if (g_conn_handle == BLE_CONN_HANDLE_INVALID || g_idle_conn_params_requested) {
		return;
	}
	if ((k_uptime_get() - g_connected_at_ms) < WEATHER_IDLE_CONN_PARAM_FALLBACK_DELAY_MS) {
		return;
	}
	g_idle_conn_params_requested = request_connected_idle_params(g_conn_handle);
}

static void request_idle_params_if_gatt_ready(void)
{
	if (g_conn_handle == BLE_CONN_HANDLE_INVALID || g_idle_conn_params_requested) {
		return;
	}
	if (!g_state_notify_enabled || !g_measurement_notify_enabled) {
		return;
	}
	g_idle_conn_params_requested = request_connected_idle_params(g_conn_handle);
}

static void set_redcon(uint8_t redcon, bool notify)
{
	const bool active = redcon < WEATHER_REDCON_IDLE;

	g_state.redcon = redcon;
	if (!active) {
		g_state.bme280_valid = false;
		g_measurement_valid = false;
	}
	led_set(active);
	publish_state(notify);
	LOG_INF("Weather state redcon=%u active=%d bme280_valid=%d", g_state.redcon, active,
		g_state.bme280_valid);
}

static void handle_command_write(const ble_gatts_evt_write_t *write)
{
	uint8_t target_redcon;

	if (write->handle != g_command_handles.value_handle) {
		return;
	}
	if (!weather_decode_command(write->data, write->len, &target_redcon)) {
		LOG_WRN("Ignoring invalid weather command len=%u", write->len);
		return;
	}

	LOG_INF("Weather command target redcon=%u", target_redcon);
	set_redcon(target_redcon, true);
}

static bool cccd_notify_enabled(const ble_gatts_evt_write_t *write)
{
	uint16_t cccd_value;

	if (write->len < 2u) {
		return false;
	}
	cccd_value = (uint16_t)write->data[0] | ((uint16_t)write->data[1] << 8u);
	return (cccd_value & BLE_GATT_HVX_NOTIFICATION) != 0u;
}

static void handle_cccd_write(const ble_gatts_evt_write_t *write)
{
	if (write->handle == g_state_handles.cccd_handle) {
		g_state_notify_enabled = cccd_notify_enabled(write);
		LOG_INF("State notifications enabled=%d", g_state_notify_enabled);
		request_idle_params_if_gatt_ready();
	} else if (write->handle == g_measurement_handles.cccd_handle) {
		g_measurement_notify_enabled = cccd_notify_enabled(write);
		LOG_INF("Measurement notifications enabled=%d", g_measurement_notify_enabled);
		request_idle_params_if_gatt_ready();
	}
}

static void handle_ble_evt(const ble_evt_t *evt, void *ctx)
{
	uint32_t nrf_err;

	(void)ctx;

	switch (evt->header.evt_id) {
	case BLE_GAP_EVT_CONNECTED: {
		const ble_gap_conn_params_t *params =
			&evt->evt.gap_evt.params.connected.conn_params;

		g_conn_handle = evt->evt.gap_evt.conn_handle;
		g_connected_at_ms = k_uptime_get();
		g_idle_conn_params_requested = false;
		g_state_notify_enabled = false;
		g_measurement_notify_enabled = false;
		LOG_INF("Peer connected; initial interval=%u..%u latency=%u supervision=%u; delaying connected-idle params for GATT discovery",
			params->min_conn_interval, params->max_conn_interval,
			params->slave_latency, params->conn_sup_timeout);
		nrf_err = sd_ble_gatts_sys_attr_set(g_conn_handle, NULL, 0, 0);
		if (nrf_err != NRF_SUCCESS) {
			LOG_DBG("Failed to set system attributes, nrf_error %#x", nrf_err);
		}
		publish_state(false);
		publish_measurement(false);
		break;
	}

	case BLE_GAP_EVT_DISCONNECTED:
		LOG_INF("Peer disconnected; restarting advertising");
		set_redcon(WEATHER_REDCON_IDLE, false);
		g_conn_handle = BLE_CONN_HANDLE_INVALID;
		g_idle_conn_params_requested = false;
		g_state_notify_enabled = false;
		g_measurement_notify_enabled = false;
		nrf_err = start_advertising();
		if (nrf_err != NRF_SUCCESS) {
			LOG_ERR("Failed to restart advertising, nrf_error %#x", nrf_err);
		}
		break;

	case BLE_GAP_EVT_CONN_PARAM_UPDATE: {
		const ble_gap_conn_params_t *params =
			&evt->evt.gap_evt.params.conn_param_update.conn_params;

		LOG_INF("Connection params updated interval=%u..%u latency=%u supervision=%u",
			params->min_conn_interval, params->max_conn_interval,
			params->slave_latency, params->conn_sup_timeout);
		break;
	}

	case BLE_GAP_EVT_SCAN_REQ_REPORT: {
		const ble_gap_evt_scan_req_report_t *report =
			&evt->evt.gap_evt.params.scan_req_report;

		LOG_INF("Scan request received rssi=%d peer=%02x:%02x:%02x:%02x:%02x:%02x",
			report->rssi, report->peer_addr.addr[5], report->peer_addr.addr[4],
			report->peer_addr.addr[3], report->peer_addr.addr[2],
			report->peer_addr.addr[1], report->peer_addr.addr[0]);
		break;
	}

	case BLE_GATTS_EVT_WRITE:
		LOG_INF("GATTS write handle=%u len=%u op=%u",
			evt->evt.gatts_evt.params.write.handle,
			evt->evt.gatts_evt.params.write.len,
			evt->evt.gatts_evt.params.write.op);
		handle_cccd_write(&evt->evt.gatts_evt.params.write);
		handle_command_write(&evt->evt.gatts_evt.params.write);
		break;

	case BLE_GATTS_EVT_HVN_TX_COMPLETE:
		LOG_DBG("GATTS HVN TX complete count=%u",
			evt->evt.gatts_evt.params.hvn_tx_complete.count);
		break;

	case BLE_GATTS_EVT_SYS_ATTR_MISSING:
		nrf_err = sd_ble_gatts_sys_attr_set(evt->evt.gatts_evt.conn_handle, NULL, 0, 0);
		if (nrf_err != NRF_SUCCESS) {
			LOG_DBG("Failed to set missing system attributes, nrf_error %#x", nrf_err);
		}
		break;

	case BLE_GATTS_EVT_EXCHANGE_MTU_REQUEST: {
		const uint16_t client_rx_mtu =
			evt->evt.gatts_evt.params.exchange_mtu_request.client_rx_mtu;

		nrf_err = sd_ble_gatts_exchange_mtu_reply(evt->evt.gatts_evt.conn_handle,
							  BLE_GATT_ATT_MTU_DEFAULT);
		if (nrf_err != NRF_SUCCESS) {
			LOG_DBG("Failed to reply to ATT MTU request, nrf_error %#x", nrf_err);
		} else {
			LOG_INF("ATT MTU exchange client_rx=%u server_rx=%u", client_rx_mtu,
				BLE_GATT_ATT_MTU_DEFAULT);
		}
		break;
	}

	case BLE_GATTC_EVT_TIMEOUT:
		(void)sd_ble_gap_disconnect(evt->evt.gattc_evt.conn_handle,
					    BLE_HCI_REMOTE_USER_TERMINATED_CONNECTION);
		break;

	case BLE_GATTS_EVT_TIMEOUT:
		(void)sd_ble_gap_disconnect(evt->evt.gatts_evt.conn_handle,
					    BLE_HCI_REMOTE_USER_TERMINATED_CONNECTION);
		break;

	default:
		break;
	}
}
NRF_SDH_BLE_OBSERVER(sdh_ble, handle_ble_evt, NULL, USER_LOW);

static void sample_weather_if_active(void)
{
	struct weather_bme280_sample sample;
	int err;

	if (g_conn_handle == BLE_CONN_HANDLE_INVALID || g_state.redcon >= WEATHER_REDCON_IDLE) {
		return;
	}
	if (!weather_bme280_ready()) {
		g_state.bme280_valid = false;
		publish_state(true);
		return;
	}

	err = weather_bme280_sample(&sample);
	if (err != 0) {
		g_state.bme280_valid = false;
		LOG_WRN("BME280 sample failed err=%d", err);
		publish_state(true);
		return;
	}

	g_measurement.temperature_centi_c = sample.temperature_centi_c;
	g_measurement.pressure_pa = sample.pressure_pa;
	g_measurement.humidity_centi_percent = sample.humidity_centi_percent;
	g_measurement.battery_mv = g_state.battery_mv;
	g_measurement_valid = true;
	g_state.bme280_valid = true;

	publish_state(true);
	publish_measurement(true);
	LOG_INF("Weather sample temp_centi=%d pressure_pa=%u humidity_centi=%u",
		g_measurement.temperature_centi_c, g_measurement.pressure_pa,
		g_measurement.humidity_centi_percent);
}

int main(void)
{
	int err;
	uint32_t nrf_err;
	char local_name[FACTORY_THING_NAME_SIZE + 1];
	bool factory_ok;
	bool softdevice_enabled = false;
	bool ble_enabled = false;
	bool gap_name_set = false;
	bool service_started = false;
	bool advertising_started = false;
	int bme280_err;
	int64_t next_sample_ms;
	int64_t next_diag_ms;

	LOG_INF("txing weather bare-metal connected-idle firmware started");

	factory_ok = read_factory_name(local_name, sizeof(local_name));
	if (!factory_ok) {
		strncpy(local_name, CONFIG_TXING_WEATHER_INVALID_NAME, sizeof(local_name) - 1u);
		local_name[sizeof(local_name) - 1u] = '\0';
		LOG_WRN("Factory data invalid; advertising fallback name %s", local_name);
	} else {
		LOG_INF("Factory thing name %s", local_name);
	}

	led_init();
	LOG_INF("XIAO LED initialized");

	bme280_err = weather_bme280_init();
	if (bme280_err != 0) {
		LOG_WRN("BME280 unavailable err=%d", bme280_err);
	} else {
		LOG_INF("BME280 initialized");
	}

	err = nrf_sdh_enable_request();
	if (err) {
		LOG_ERR("Failed to enable SoftDevice, err %d", err);
		goto idle;
	}
	softdevice_enabled = true;
	LOG_INF("SoftDevice enabled");

	err = nrf_sdh_ble_enable(CONFIG_NRF_SDH_BLE_CONN_TAG);
	if (err) {
		LOG_ERR("Failed to enable BLE, err %d", err);
		goto idle;
	}
	ble_enabled = true;
	LOG_INF("BLE enabled");

	nrf_err = set_gap_device_name(local_name);
	if (nrf_err != NRF_SUCCESS) {
		LOG_ERR("Failed to set GAP device name, nrf_error %#x", nrf_err);
		goto idle;
	}
	gap_name_set = true;
	LOG_INF("GAP device name set");

	nrf_err = weather_service_init();
	if (nrf_err != NRF_SUCCESS) {
		LOG_ERR("Failed to initialize weather GATT service, nrf_error %#x", nrf_err);
		goto idle;
	}
	service_started = true;
	LOG_INF("Weather GATT service initialized");

	nrf_err = start_advertising();
	if (nrf_err != NRF_SUCCESS) {
		LOG_ERR("Failed to start advertising, nrf_error %#x", nrf_err);
		goto idle;
	}
	advertising_started = true;

	LOG_INF("Advertising as %s", local_name);

idle:
	next_sample_ms = k_uptime_get() + WEATHER_SAMPLE_INTERVAL_MS;
	next_diag_ms = k_uptime_get() + WEATHER_DIAG_INTERVAL_MS;

	while (true) {
		const int64_t now_ms = k_uptime_get();

		if (now_ms >= next_sample_ms) {
			next_sample_ms = now_ms + WEATHER_SAMPLE_INTERVAL_MS;
			sample_weather_if_active();
		}
		request_idle_params_if_ready();
		if (now_ms >= next_diag_ms) {
			next_diag_ms = now_ms + WEATHER_DIAG_INTERVAL_MS;
			LOG_INF("diag name=%s factory_ok=%d softdevice=%d ble=%d gap_name=%d service=%d adv=%d conn=%u redcon=%u bme280=%d",
				local_name, factory_ok, softdevice_enabled, ble_enabled, gap_name_set,
				service_started, advertising_started, g_conn_handle, g_state.redcon,
				weather_bme280_ready());
		}
		log_flush();
		k_sleep(K_MSEC(100));
	}

	return 0;
}
```

## src/weather_bme280.c
```c
#include "weather_bme280.h"

#include <errno.h>
#include <nrfx_twim.h>
#include <hal/nrf_gpio.h>

#include <zephyr/kernel.h>

#include <stddef.h>
#include <stdint.h>
#include <string.h>

#define BME280_ADDR 0x76u
#define BME280_CHIP_ID 0x60u

#define REG_ID 0xd0u
#define REG_RESET 0xe0u
#define REG_CTRL_HUM 0xf2u
#define REG_STATUS 0xf3u
#define REG_CTRL_MEAS 0xf4u
#define REG_CONFIG 0xf5u
#define REG_PRESS_MSB 0xf7u
#define REG_CALIB_00 0x88u
#define REG_CALIB_26 0xe1u

#define XIAO_I2C_SDA_PIN NRF_PIN_PORT_TO_PIN_NUMBER(10, 1)
#define XIAO_I2C_SCL_PIN NRF_PIN_PORT_TO_PIN_NUMBER(11, 1)

struct bme280_calibration {
	uint16_t dig_t1;
	int16_t dig_t2;
	int16_t dig_t3;
	uint16_t dig_p1;
	int16_t dig_p2;
	int16_t dig_p3;
	int16_t dig_p4;
	int16_t dig_p5;
	int16_t dig_p6;
	int16_t dig_p7;
	int16_t dig_p8;
	int16_t dig_p9;
	uint8_t dig_h1;
	int16_t dig_h2;
	uint8_t dig_h3;
	int16_t dig_h4;
	int16_t dig_h5;
	int8_t dig_h6;
};

static nrfx_twim_t g_twim = NRFX_TWIM_INSTANCE(NRF_TWIM22);
static struct bme280_calibration g_calibration;
static bool g_ready;
static int32_t g_t_fine;

static uint16_t u16_le(const uint8_t *data)
{
	return (uint16_t)data[0] | ((uint16_t)data[1] << 8);
}

static int16_t s16_le(const uint8_t *data)
{
	return (int16_t)u16_le(data);
}

static int16_t s12_from_u16(uint16_t value)
{
	if ((value & 0x0800u) != 0u) {
		value |= 0xf000u;
	}
	return (int16_t)value;
}

static int twim_write(uint8_t reg, const uint8_t *data, size_t len)
{
	uint8_t buffer[8];
	nrfx_twim_xfer_desc_t desc;

	if (len + 1u > sizeof(buffer)) {
		return -EINVAL;
	}

	buffer[0] = reg;
	if (len > 0u) {
		memcpy(&buffer[1], data, len);
	}

	desc = (nrfx_twim_xfer_desc_t)NRFX_TWIM_XFER_DESC_TX(BME280_ADDR, buffer, len + 1u);
	return nrfx_twim_xfer(&g_twim, &desc, 0);
}

static int twim_write_u8(uint8_t reg, uint8_t value)
{
	return twim_write(reg, &value, 1u);
}

static int twim_read(uint8_t reg, uint8_t *data, size_t len)
{
	nrfx_twim_xfer_desc_t tx_desc =
		NRFX_TWIM_XFER_DESC_TX(BME280_ADDR, &reg, sizeof(reg));
	nrfx_twim_xfer_desc_t rx_desc =
		NRFX_TWIM_XFER_DESC_RX(BME280_ADDR, data, len);
	int err;

	err = nrfx_twim_xfer(&g_twim, &tx_desc, NRFX_TWIM_FLAG_TX_NO_STOP);
	if (err != 0) {
		return err;
	}
	return nrfx_twim_xfer(&g_twim, &rx_desc, 0);
}

static int read_calibration(void)
{
	uint8_t c0[26];
	uint8_t c1[7];
	int err;

	err = twim_read(REG_CALIB_00, c0, sizeof(c0));
	if (err != 0) {
		return err;
	}
	err = twim_read(REG_CALIB_26, c1, sizeof(c1));
	if (err != 0) {
		return err;
	}

	g_calibration.dig_t1 = u16_le(&c0[0]);
	g_calibration.dig_t2 = s16_le(&c0[2]);
	g_calibration.dig_t3 = s16_le(&c0[4]);
	g_calibration.dig_p1 = u16_le(&c0[6]);
	g_calibration.dig_p2 = s16_le(&c0[8]);
	g_calibration.dig_p3 = s16_le(&c0[10]);
	g_calibration.dig_p4 = s16_le(&c0[12]);
	g_calibration.dig_p5 = s16_le(&c0[14]);
	g_calibration.dig_p6 = s16_le(&c0[16]);
	g_calibration.dig_p7 = s16_le(&c0[18]);
	g_calibration.dig_p8 = s16_le(&c0[20]);
	g_calibration.dig_p9 = s16_le(&c0[22]);
	g_calibration.dig_h1 = c0[25];
	g_calibration.dig_h2 = s16_le(&c1[0]);
	g_calibration.dig_h3 = c1[2];
	g_calibration.dig_h4 = s12_from_u16(((uint16_t)c1[3] << 4) | (c1[4] & 0x0fu));
	g_calibration.dig_h5 = s12_from_u16(((uint16_t)c1[5] << 4) | (c1[4] >> 4));
	g_calibration.dig_h6 = (int8_t)c1[6];

	if (g_calibration.dig_t1 == 0u || g_calibration.dig_p1 == 0u) {
		return -EIO;
	}
	return 0;
}

static int32_t compensate_temperature(int32_t adc_t)
{
	int32_t var1;
	int32_t var2;

	var1 = ((((adc_t >> 3) - ((int32_t)g_calibration.dig_t1 << 1))) *
		((int32_t)g_calibration.dig_t2)) >> 11;
	var2 = (((((adc_t >> 4) - ((int32_t)g_calibration.dig_t1)) *
		  ((adc_t >> 4) - ((int32_t)g_calibration.dig_t1))) >> 12) *
		((int32_t)g_calibration.dig_t3)) >> 14;
	g_t_fine = var1 + var2;
	return (g_t_fine * 5 + 128) >> 8;
}

static uint32_t compensate_pressure(int32_t adc_p)
{
	int64_t var1;
	int64_t var2;
	int64_t p;

	var1 = ((int64_t)g_t_fine) - 128000;
	var2 = var1 * var1 * (int64_t)g_calibration.dig_p6;
	var2 = var2 + ((var1 * (int64_t)g_calibration.dig_p5) << 17);
	var2 = var2 + (((int64_t)g_calibration.dig_p4) << 35);
	var1 = ((var1 * var1 * (int64_t)g_calibration.dig_p3) >> 8) +
	       ((var1 * (int64_t)g_calibration.dig_p2) << 12);
	var1 = (((((int64_t)1) << 47) + var1) * (int64_t)g_calibration.dig_p1) >> 33;
	if (var1 == 0) {
		return 0u;
	}
	p = 1048576 - adc_p;
	p = (((p << 31) - var2) * 3125) / var1;
	var1 = ((int64_t)g_calibration.dig_p9 * (p >> 13) * (p >> 13)) >> 25;
	var2 = ((int64_t)g_calibration.dig_p8 * p) >> 19;
	p = ((p + var1 + var2) >> 8) + (((int64_t)g_calibration.dig_p7) << 4);
	if (p < 0) {
		return 0u;
	}
	return (uint32_t)(p >> 8);
}

static uint16_t compensate_humidity(int32_t adc_h)
{
	int32_t v_x1_u32r;
	uint32_t humidity_q1024;
	uint32_t humidity_centi;

	v_x1_u32r = g_t_fine - 76800;
	v_x1_u32r = (((((adc_h << 14) - (((int32_t)g_calibration.dig_h4) << 20) -
			(((int32_t)g_calibration.dig_h5) * v_x1_u32r)) + 16384) >> 15) *
		      (((((((v_x1_u32r * ((int32_t)g_calibration.dig_h6)) >> 10) *
			   (((v_x1_u32r * ((int32_t)g_calibration.dig_h3)) >> 11) +
			    32768)) >> 10) + 2097152) *
			((int32_t)g_calibration.dig_h2) + 8192) >> 14));
	v_x1_u32r = v_x1_u32r -
		    (((((v_x1_u32r >> 15) * (v_x1_u32r >> 15)) >> 7) *
		      ((int32_t)g_calibration.dig_h1)) >> 4);
	if (v_x1_u32r < 0) {
		v_x1_u32r = 0;
	}
	if (v_x1_u32r > 419430400) {
		v_x1_u32r = 419430400;
	}
	humidity_q1024 = (uint32_t)(v_x1_u32r >> 12);
	humidity_centi = (humidity_q1024 * 100u + 512u) / 1024u;
	if (humidity_centi > 10000u) {
		humidity_centi = 10000u;
	}
	return (uint16_t)humidity_centi;
}

int weather_bme280_init(void)
{
	nrfx_twim_config_t config =
		NRFX_TWIM_DEFAULT_CONFIG(XIAO_I2C_SCL_PIN, XIAO_I2C_SDA_PIN);
	uint8_t chip_id = 0u;
	int err;

	if (!nrfx_twim_init_check(&g_twim)) {
		err = nrfx_twim_init(&g_twim, &config, NULL, NULL);
		if (err != 0) {
			return err;
		}
	}
	nrfx_twim_enable(&g_twim);

	err = twim_read(REG_ID, &chip_id, sizeof(chip_id));
	if (err != 0) {
		return err;
	}
	if (chip_id != BME280_CHIP_ID) {
		return -ENODEV;
	}

	err = read_calibration();
	if (err != 0) {
		return err;
	}

	err = twim_write_u8(REG_CTRL_HUM, 0x01u);
	if (err != 0) {
		return err;
	}
	err = twim_write_u8(REG_CONFIG, 0x00u);
	if (err != 0) {
		return err;
	}

	g_ready = true;
	return 0;
}

bool weather_bme280_ready(void)
{
	return g_ready;
}

int weather_bme280_sample(struct weather_bme280_sample *sample)
{
	uint8_t data[8];
	uint8_t status = 0u;
	int32_t adc_p;
	int32_t adc_t;
	int32_t adc_h;
	int err;

	if (!g_ready || sample == NULL) {
		return -ENODEV;
	}

	err = twim_write_u8(REG_CTRL_HUM, 0x01u);
	if (err != 0) {
		return err;
	}
	err = twim_write_u8(REG_CTRL_MEAS, 0x25u);
	if (err != 0) {
		return err;
	}

	for (int attempt = 0; attempt < 10; ++attempt) {
		k_sleep(K_MSEC(10));
		err = twim_read(REG_STATUS, &status, sizeof(status));
		if (err != 0) {
			return err;
		}
		if ((status & 0x08u) == 0u) {
			break;
		}
	}

	err = twim_read(REG_PRESS_MSB, data, sizeof(data));
	if (err != 0) {
		return err;
	}

	adc_p = ((int32_t)data[0] << 12) | ((int32_t)data[1] << 4) | ((int32_t)data[2] >> 4);
	adc_t = ((int32_t)data[3] << 12) | ((int32_t)data[4] << 4) | ((int32_t)data[5] >> 4);
	adc_h = ((int32_t)data[6] << 8) | (int32_t)data[7];

	sample->temperature_centi_c = compensate_temperature(adc_t);
	sample->pressure_pa = compensate_pressure(adc_p);
	sample->humidity_centi_percent = compensate_humidity(adc_h);
	return 0;
}
```

## src/weather_bme280.h
```c
#ifndef TXING_WEATHER_BME280_H_
#define TXING_WEATHER_BME280_H_

#include <stdbool.h>
#include <stdint.h>

struct weather_bme280_sample {
	int32_t temperature_centi_c;
	uint32_t pressure_pa;
	uint16_t humidity_centi_percent;
};

int weather_bme280_init(void);
bool weather_bme280_ready(void);
int weather_bme280_sample(struct weather_bme280_sample *sample);

#endif
```
