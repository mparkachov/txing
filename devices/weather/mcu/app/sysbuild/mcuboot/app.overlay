/ {
	chosen {
		zephyr,code-partition = &boot_partition;
	};
};

/*
 * nRF54L flash protection can cover at most 62 KiB. The XIAO board leaves
 * slot0 at 0x10000, so this keeps a 2 KiB gap before the app slot.
 */
&boot_partition {
	reg = <0x0 DT_SIZE_K(62)>;
};
