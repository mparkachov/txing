## CMakeLists.txt
```
cmake_minimum_required(VERSION 3.20.0)

find_package(Zephyr REQUIRED HINTS $ENV{ZEPHYR_BASE})
project(txing_weather_ble_debug)

target_sources(app PRIVATE
  src/main.c
  src/weather_battery.c
  src/weather_bme280.c
  src/weather_protocol.c
)
```

## Kconfig
```
menu "txing weather BLE debug SoftDevice firmware"

config TXING_WEATHER_FACTORY_DATA_ADDR
	hex "Weather factory data flash address"
	default 0x000f0000

config TXING_WEATHER_ADV_INTERVAL_625US
	int "Advertising interval in 625 us units"
	default 160
	help
	  160 is 100 ms.

config TXING_WEATHER_ADV_TX_POWER_DBM
	int "Advertising transmit power in dBm"
	default 8

config TXING_WEATHER_SCAN_REQ_NOTIFY
	bool "Enable scan request events"
	default n
	help
	  Enable only when debugging advertisement/scanner behavior. Scan request
	  events wake the application and generate logs while advertising.

config TXING_WEATHER_ACTIVE_CONN_INTERVAL_MS
	int "Connected active connection interval in milliseconds"
	default 100
	help
	  Requested BLE connection interval while REDCON is active.

config TXING_WEATHER_ACTIVE_CONN_LATENCY
	int "Connected active peripheral latency"
	default 0

config TXING_WEATHER_ACTIVE_CONN_SUPERVISION_TIMEOUT_MS
	int "Connected active supervision timeout in milliseconds"
	default 10000
	help
	  Requested BLE supervision timeout while REDCON is active.

config TXING_WEATHER_IDLE_CONN_INTERVAL_MS
	int "Connected idle connection interval in milliseconds"
	default 100
	help
	  Requested minimum and maximum BLE connection interval after GATT setup.
	  The value must map exactly to BLE 1.25 ms interval units.

config TXING_WEATHER_IDLE_CONN_LATENCY
	int "Connected idle peripheral latency"
	default 0

config TXING_WEATHER_IDLE_CONN_SUPERVISION_TIMEOUT_MS
	int "Connected idle supervision timeout in milliseconds"
	default 6000
	help
	  Requested BLE supervision timeout after GATT setup. The value must map
	  exactly to BLE 10 ms timeout units.

config TXING_WEATHER_IDLE_CONN_PARAM_FALLBACK_DELAY_MS
	int "Connected idle connection parameter fallback delay in milliseconds"
	default 10000
	help
	  Fallback delay before requesting the idle connection parameters when the
	  central has not subscribed to all debug notifications yet.

config TXING_WEATHER_IDLE_CONN_PARAM_INITIAL_DELAY_MS
	int "Connected idle connection parameter initial delay in milliseconds"
	default 250
	help
	  Delay after connection before requesting the selected debug connection
	  parameters even if GATT discovery has not finished yet. This gives Linux
	  BlueZ a longer supervision timeout before service discovery can time out
	  on a weak link. Set negative to disable the initial request and use only
	  the GATT-ready or fallback paths.

config TXING_WEATHER_IDLE_DIAG_ENABLE
	bool "Enable periodic idle diagnostics"
	default n
	help
	  Keep disabled for current measurements. Periodic diagnostics wake the CPU
	  and keep log traffic alive while the device is otherwise idle.

config TXING_WEATHER_IDLE_BATTERY_REPORT_ENABLE
	bool "Sample and notify battery periodically while idle"
	default n
	help
	  Keep disabled for current measurements. Battery is still sampled during
	  active REDCON measurement streaming.

config TXING_WEATHER_IDLE_LOG_FLUSH_ENABLE
	bool "Flush deferred logs from the idle loop"
	default n
	help
	  Enable only when watching RTT logs. Disabled by default so connected idle
	  can sleep until a BLE interrupt instead of waking only to drain logs.

config TXING_WEATHER_SYSTEM_OFF_TEST
	bool "Run floor-current System OFF test instead of BLE firmware"
	default n
	help
	  Build a measurement-only image that does not start SoftDevice, BLE,
	  BME280, battery ADC, or advertising. It waits briefly after boot with
	  the board power output off, then enters nRF54 System OFF.

config TXING_WEATHER_SYSTEM_OFF_TEST_DELAY_MS
	int "Delay before entering System OFF in the floor-current test"
	default 5000
	depends on TXING_WEATHER_SYSTEM_OFF_TEST

config TXING_WEATHER_INVALID_NAME
	string "Fallback local name when factory data is invalid"
	default "TxingWeatherInvalid"

module=TXING_WEATHER_BLE_DEBUG
module-str=txing weather BLE debug SoftDevice firmware
source "$(ZEPHYR_BASE)/subsys/logging/Kconfig.template.log_config"

endmenu

source "Kconfig.zephyr"
```

## sample.yaml
```
sample:
  name: txing weather BLE debug SoftDevice firmware
  description: S115 connected-idle BLE debug firmware for txing weather devices.
tests:
  sample.txing.weather_ble_debug:
    platform_allow:
      - bm_nrf54l15dk/nrf54l15/cpuapp/s115_softdevice
    integration_platforms:
      - bm_nrf54l15dk/nrf54l15/cpuapp/s115_softdevice
```

## prj.conf
```kconfig
# Logging is compiled out by default for current measurement builds. Re-enable
# LOG/RTT only for focused firmware investigations; it changes the idle image.
CONFIG_LOG=n
CONFIG_CONSOLE=n
CONFIG_BM_UARTE_CONSOLE=n
CONFIG_LOG_BACKEND_BM_UARTE=n
CONFIG_USE_SEGGER_RTT=n

# SoftDevice S115
CONFIG_SOFTDEVICE=y
CONFIG_NRF_SDH_BLE_VS_UUID_COUNT=1
CONFIG_NRF_SDH_BLE_SERVICE_CHANGED=n
CONFIG_NRF_SDH_STR_TABLES=n

# S115 needs the SoftDevice random seed path for reliable BLE startup on
# nRF54L15. Keep this enabled even for open, unencrypted debug GATT.
CONFIG_NRF_SECURITY=y
CONFIG_MBEDTLS_PSA_CRYPTO_C=y
CONFIG_PSA_WANT_GENERATE_RANDOM=y
CONFIG_NRF_SDH_SOC_RAND_SEED=y

# Advertising data encoder.
CONFIG_BLE_ADV=y

# Grove BME280 over XIAO I2C connector.
CONFIG_NRFX_TWIM=y

# XIAO battery divider on AIN7/P1.14 with VBAT switch enable on P1.15.
CONFIG_NRFX_SAADC=y

# The BM XIAO board defconfig enables every nrfx driver for convenience.
# Override that for current measurement builds; the debug app only needs
# CLOCK/POWER/GRTC/SYSTICK/RRAMC plus TWIM and SAADC at runtime.
CONFIG_NRFX_COMP=n
CONFIG_NRFX_EGU10=n
CONFIG_NRFX_EGU20=n
CONFIG_NRFX_GPIOTE20=n
CONFIG_NRFX_GPIOTE30=n
CONFIG_NRFX_GPPI=n
CONFIG_NRFX_I2S=n
CONFIG_NRFX_NFCT=n
CONFIG_NRFX_PDM=n
CONFIG_NRFX_PWM=n
CONFIG_NRFX_QDEC=n
CONFIG_NRFX_SPIM=n
CONFIG_NRFX_TEMP=n
CONFIG_NRFX_TIMER=n
CONFIG_NRFX_UARTE=n
CONFIG_NRFX_WDT=n
```

## src/weather_battery.c
```c
#include "weather_battery.h"

#include <hal/nrf_gpio.h>
#include <nrfx_saadc.h>

#include <zephyr/kernel.h>
#include <zephyr/logging/log.h>

#include <stdbool.h>
#include <stdint.h>

#ifndef CONFIG_TXING_WEATHER_BLE_DEBUG_LOG_LEVEL
#define CONFIG_TXING_WEATHER_BLE_DEBUG_LOG_LEVEL 0
#endif

LOG_MODULE_REGISTER(txing_weather_battery, CONFIG_TXING_WEATHER_BLE_DEBUG_LOG_LEVEL);

#define XIAO_VBAT_AIN_PIN NRF_PIN_PORT_TO_PIN_NUMBER(14, 1)
#define XIAO_VBAT_ENABLE_PIN NRF_PIN_PORT_TO_PIN_NUMBER(15, 1)
#define XIAO_VBAT_ENABLE_ACTIVE_STATE 1u
#define XIAO_VBAT_SETTLE_MS 100u
#define XIAO_VBAT_DIVIDER_NUMERATOR 2u
#define XIAO_VBAT_DIVIDER_DENOMINATOR 1u
#define BATTERY_SAADC_CHANNEL_INDEX 0u
#define BATTERY_SAADC_RESOLUTION NRF_SAADC_RESOLUTION_12BIT

static nrf_saadc_value_t g_sample;
static bool g_ready;

static void vbat_enable(bool enabled)
{
	nrf_gpio_pin_write(XIAO_VBAT_ENABLE_PIN,
			   enabled ? XIAO_VBAT_ENABLE_ACTIVE_STATE :
				     !XIAO_VBAT_ENABLE_ACTIVE_STATE);
}

static int init_failed(int err)
{
	nrfx_saadc_uninit();
	vbat_enable(false);
	return err;
}

int weather_battery_init(void)
{
	nrfx_saadc_channel_t channel =
		NRFX_SAADC_DEFAULT_CHANNEL_SE(NRFX_ANALOG_EXTERNAL_AIN7,
					      BATTERY_SAADC_CHANNEL_INDEX);
	uint32_t channels_mask;
	int err;

	g_ready = false;
	nrf_gpio_cfg_default(XIAO_VBAT_AIN_PIN);
#if NRF_GPIO_HAS_SEL
	nrf_gpio_pin_control_select(XIAO_VBAT_ENABLE_PIN, NRF_GPIO_PIN_SEL_GPIO);
#endif
	vbat_enable(false);
	nrf_gpio_cfg_output(XIAO_VBAT_ENABLE_PIN);

	err = nrfx_saadc_init(NRFX_SAADC_DEFAULT_CONFIG_IRQ_PRIORITY);
	if (err != 0) {
		return err;
	}

	channel.channel_config.gain = NRF_SAADC_GAIN1_4;
#if NRF_SAADC_HAS_ACQTIME_ENUM
	channel.channel_config.acq_time = NRF_SAADC_ACQTIME_40US;
#else
	channel.channel_config.acq_time = 40;
#endif

	err = nrfx_saadc_channel_config(&channel);
	if (err != 0) {
		return init_failed(err);
	}

	channels_mask = nrfx_saadc_channels_configured_get();
	err = nrfx_saadc_simple_mode_set(channels_mask, BATTERY_SAADC_RESOLUTION,
					 NRF_SAADC_OVERSAMPLE_8X, NULL);
	if (err != 0) {
		return init_failed(err);
	}

	err = nrfx_saadc_offset_calibrate(NULL);
	if (err != 0) {
		return init_failed(err);
	}

	g_ready = true;
	LOG_INF("Battery ADC initialized input=AIN7/P1.14 enable=P1.15 divider=2");
	return 0;
}

void weather_battery_shutdown(void)
{
	if (g_ready) {
		nrfx_saadc_uninit();
		g_ready = false;
	}
	vbat_enable(false);
	nrf_gpio_cfg_default(XIAO_VBAT_AIN_PIN);
#if NRF_GPIO_HAS_SEL
	nrf_gpio_pin_control_select(XIAO_VBAT_ENABLE_PIN, NRF_GPIO_PIN_SEL_GPIO);
#endif
	nrf_gpio_cfg_output(XIAO_VBAT_ENABLE_PIN);
}

uint16_t weather_battery_sample_mv(void)
{
	const uint32_t full_scale = (uint32_t)nrf_saadc_value_max_get(BATTERY_SAADC_RESOLUTION);
	int64_t mv;
	int err;

	if (!g_ready) {
		return 0u;
	}

	vbat_enable(true);
	k_sleep(K_MSEC(XIAO_VBAT_SETTLE_MS));

	err = nrfx_saadc_buffer_set(&g_sample, 1);
	if (err == 0) {
		err = nrfx_saadc_mode_trigger();
	}

	vbat_enable(false);
	if (err != 0 || g_sample <= 0 || full_scale == 0u) {
		LOG_WRN("Battery sample failed err=%d raw=%d", err, g_sample);
		return 0u;
	}

	mv = (int64_t)g_sample * NRFX_SAADC_REF_INTERNAL_VALUE;
	mv *= 4;
	mv *= XIAO_VBAT_DIVIDER_NUMERATOR;
	mv /= XIAO_VBAT_DIVIDER_DENOMINATOR;
	mv = (mv + (full_scale / 2)) / full_scale;

	if (mv < 0 || mv > UINT16_MAX) {
		return 0u;
	}
	return (uint16_t)mv;
}
```

## src/weather_battery.h
```c
#ifndef TXING_WEATHER_BATTERY_H_
#define TXING_WEATHER_BATTERY_H_

#include <stdint.h>

int weather_battery_init(void);
void weather_battery_shutdown(void);
uint16_t weather_battery_sample_mv(void);

#endif
```

## src/weather_bme280.c
```c
#include "weather_bme280.h"

#include <errno.h>
#include <nrfx_twim.h>
#include <hal/nrf_gpio.h>

#include <zephyr/kernel.h>

#include <stddef.h>
#include <stdint.h>
#include <string.h>

#define BME280_ADDR 0x76u
#define BME280_CHIP_ID 0x60u

#define REG_ID 0xd0u
#define REG_RESET 0xe0u
#define REG_CTRL_HUM 0xf2u
#define REG_STATUS 0xf3u
#define REG_CTRL_MEAS 0xf4u
#define REG_CONFIG 0xf5u
#define REG_PRESS_MSB 0xf7u
#define REG_CALIB_00 0x88u
#define REG_CALIB_26 0xe1u

#define XIAO_I2C_SDA_PIN NRF_PIN_PORT_TO_PIN_NUMBER(10, 1)
#define XIAO_I2C_SCL_PIN NRF_PIN_PORT_TO_PIN_NUMBER(11, 1)

struct bme280_calibration {
	uint16_t dig_t1;
	int16_t dig_t2;
	int16_t dig_t3;
	uint16_t dig_p1;
	int16_t dig_p2;
	int16_t dig_p3;
	int16_t dig_p4;
	int16_t dig_p5;
	int16_t dig_p6;
	int16_t dig_p7;
	int16_t dig_p8;
	int16_t dig_p9;
	uint8_t dig_h1;
	int16_t dig_h2;
	uint8_t dig_h3;
	int16_t dig_h4;
	int16_t dig_h5;
	int8_t dig_h6;
};

static nrfx_twim_t g_twim = NRFX_TWIM_INSTANCE(NRF_TWIM22);
static struct bme280_calibration g_calibration;
static bool g_ready;
static int32_t g_t_fine;

static uint16_t u16_le(const uint8_t *data)
{
	return (uint16_t)data[0] | ((uint16_t)data[1] << 8);
}

static int16_t s16_le(const uint8_t *data)
{
	return (int16_t)u16_le(data);
}

static int16_t s12_from_u16(uint16_t value)
{
	if ((value & 0x0800u) != 0u) {
		value |= 0xf000u;
	}
	return (int16_t)value;
}

static int twim_write(uint8_t reg, const uint8_t *data, size_t len)
{
	uint8_t buffer[8];
	nrfx_twim_xfer_desc_t desc;

	if (len + 1u > sizeof(buffer)) {
		return -EINVAL;
	}

	buffer[0] = reg;
	if (len > 0u) {
		memcpy(&buffer[1], data, len);
	}

	desc = (nrfx_twim_xfer_desc_t)NRFX_TWIM_XFER_DESC_TX(BME280_ADDR, buffer, len + 1u);
	return nrfx_twim_xfer(&g_twim, &desc, 0);
}

static int twim_write_u8(uint8_t reg, uint8_t value)
{
	return twim_write(reg, &value, 1u);
}

static int twim_read(uint8_t reg, uint8_t *data, size_t len)
{
	nrfx_twim_xfer_desc_t tx_desc =
		NRFX_TWIM_XFER_DESC_TX(BME280_ADDR, &reg, sizeof(reg));
	nrfx_twim_xfer_desc_t rx_desc =
		NRFX_TWIM_XFER_DESC_RX(BME280_ADDR, data, len);
	int err;

	err = nrfx_twim_xfer(&g_twim, &tx_desc, NRFX_TWIM_FLAG_TX_NO_STOP);
	if (err != 0) {
		return err;
	}
	return nrfx_twim_xfer(&g_twim, &rx_desc, 0);
}

static int read_calibration(void)
{
	uint8_t c0[26];
	uint8_t c1[7];
	int err;

	err = twim_read(REG_CALIB_00, c0, sizeof(c0));
	if (err != 0) {
		return err;
	}
	err = twim_read(REG_CALIB_26, c1, sizeof(c1));
	if (err != 0) {
		return err;
	}

	g_calibration.dig_t1 = u16_le(&c0[0]);
	g_calibration.dig_t2 = s16_le(&c0[2]);
	g_calibration.dig_t3 = s16_le(&c0[4]);
	g_calibration.dig_p1 = u16_le(&c0[6]);
	g_calibration.dig_p2 = s16_le(&c0[8]);
	g_calibration.dig_p3 = s16_le(&c0[10]);
	g_calibration.dig_p4 = s16_le(&c0[12]);
	g_calibration.dig_p5 = s16_le(&c0[14]);
	g_calibration.dig_p6 = s16_le(&c0[16]);
	g_calibration.dig_p7 = s16_le(&c0[18]);
	g_calibration.dig_p8 = s16_le(&c0[20]);
	g_calibration.dig_p9 = s16_le(&c0[22]);
	g_calibration.dig_h1 = c0[25];
	g_calibration.dig_h2 = s16_le(&c1[0]);
	g_calibration.dig_h3 = c1[2];
	g_calibration.dig_h4 = s12_from_u16(((uint16_t)c1[3] << 4) | (c1[4] & 0x0fu));
	g_calibration.dig_h5 = s12_from_u16(((uint16_t)c1[5] << 4) | (c1[4] >> 4));
	g_calibration.dig_h6 = (int8_t)c1[6];

	if (g_calibration.dig_t1 == 0u || g_calibration.dig_p1 == 0u) {
		return -EIO;
	}
	return 0;
}

static int init_failed(int err)
{
	weather_bme280_reset();
	return err;
}

static int32_t compensate_temperature(int32_t adc_t)
{
	int32_t var1;
	int32_t var2;

	var1 = ((((adc_t >> 3) - ((int32_t)g_calibration.dig_t1 << 1))) *
		((int32_t)g_calibration.dig_t2)) >> 11;
	var2 = (((((adc_t >> 4) - ((int32_t)g_calibration.dig_t1)) *
		  ((adc_t >> 4) - ((int32_t)g_calibration.dig_t1))) >> 12) *
		((int32_t)g_calibration.dig_t3)) >> 14;
	g_t_fine = var1 + var2;
	return (g_t_fine * 5 + 128) >> 8;
}

static uint32_t compensate_pressure(int32_t adc_p)
{
	int64_t var1;
	int64_t var2;
	int64_t p;

	var1 = ((int64_t)g_t_fine) - 128000;
	var2 = var1 * var1 * (int64_t)g_calibration.dig_p6;
	var2 = var2 + ((var1 * (int64_t)g_calibration.dig_p5) << 17);
	var2 = var2 + (((int64_t)g_calibration.dig_p4) << 35);
	var1 = ((var1 * var1 * (int64_t)g_calibration.dig_p3) >> 8) +
	       ((var1 * (int64_t)g_calibration.dig_p2) << 12);
	var1 = (((((int64_t)1) << 47) + var1) * (int64_t)g_calibration.dig_p1) >> 33;
	if (var1 == 0) {
		return 0u;
	}
	p = 1048576 - adc_p;
	p = (((p << 31) - var2) * 3125) / var1;
	var1 = ((int64_t)g_calibration.dig_p9 * (p >> 13) * (p >> 13)) >> 25;
	var2 = ((int64_t)g_calibration.dig_p8 * p) >> 19;
	p = ((p + var1 + var2) >> 8) + (((int64_t)g_calibration.dig_p7) << 4);
	if (p < 0) {
		return 0u;
	}
	return (uint32_t)(p >> 8);
}

static uint16_t compensate_humidity(int32_t adc_h)
{
	int32_t v_x1_u32r;
	uint32_t humidity_q1024;
	uint32_t humidity_centi;

	v_x1_u32r = g_t_fine - 76800;
	v_x1_u32r = (((((adc_h << 14) - (((int32_t)g_calibration.dig_h4) << 20) -
			(((int32_t)g_calibration.dig_h5) * v_x1_u32r)) + 16384) >> 15) *
		      (((((((v_x1_u32r * ((int32_t)g_calibration.dig_h6)) >> 10) *
			   (((v_x1_u32r * ((int32_t)g_calibration.dig_h3)) >> 11) +
			    32768)) >> 10) + 2097152) *
			((int32_t)g_calibration.dig_h2) + 8192) >> 14));
	v_x1_u32r = v_x1_u32r -
		    (((((v_x1_u32r >> 15) * (v_x1_u32r >> 15)) >> 7) *
		      ((int32_t)g_calibration.dig_h1)) >> 4);
	if (v_x1_u32r < 0) {
		v_x1_u32r = 0;
	}
	if (v_x1_u32r > 419430400) {
		v_x1_u32r = 419430400;
	}
	humidity_q1024 = (uint32_t)(v_x1_u32r >> 12);
	humidity_centi = (humidity_q1024 * 100u + 512u) / 1024u;
	if (humidity_centi > 10000u) {
		humidity_centi = 10000u;
	}
	return (uint16_t)humidity_centi;
}

int weather_bme280_init(void)
{
	nrfx_twim_config_t config =
		NRFX_TWIM_DEFAULT_CONFIG(XIAO_I2C_SCL_PIN, XIAO_I2C_SDA_PIN);
	uint8_t chip_id = 0u;
	int err;

	g_ready = false;
	memset(&g_calibration, 0, sizeof(g_calibration));

	if (!nrfx_twim_init_check(&g_twim)) {
		err = nrfx_twim_init(&g_twim, &config, NULL, NULL);
		if (err != 0) {
			return err;
		}
	}
	nrfx_twim_enable(&g_twim);

	err = twim_read(REG_ID, &chip_id, sizeof(chip_id));
	if (err != 0) {
		return init_failed(err);
	}
	if (chip_id != BME280_CHIP_ID) {
		return init_failed(-ENODEV);
	}

	err = read_calibration();
	if (err != 0) {
		return init_failed(err);
	}

	err = twim_write_u8(REG_CTRL_HUM, 0x01u);
	if (err != 0) {
		return init_failed(err);
	}
	err = twim_write_u8(REG_CONFIG, 0x00u);
	if (err != 0) {
		return init_failed(err);
	}

	g_ready = true;
	return 0;
}

void weather_bme280_reset(void)
{
	if (nrfx_twim_init_check(&g_twim)) {
		nrfx_twim_uninit(&g_twim);
	}
	nrf_gpio_cfg_default(XIAO_I2C_SCL_PIN);
	nrf_gpio_cfg_default(XIAO_I2C_SDA_PIN);
	memset(&g_calibration, 0, sizeof(g_calibration));
	g_ready = false;
	g_t_fine = 0;
}

bool weather_bme280_ready(void)
{
	return g_ready;
}

int weather_bme280_sample(struct weather_bme280_sample *sample)
{
	uint8_t data[8];
	uint8_t status = 0u;
	int32_t adc_p;
	int32_t adc_t;
	int32_t adc_h;
	int err;

	if (!g_ready || sample == NULL) {
		return -ENODEV;
	}

	err = twim_write_u8(REG_CTRL_HUM, 0x01u);
	if (err != 0) {
		return err;
	}
	err = twim_write_u8(REG_CTRL_MEAS, 0x25u);
	if (err != 0) {
		return err;
	}

	for (int attempt = 0; attempt < 10; ++attempt) {
		k_sleep(K_MSEC(10));
		err = twim_read(REG_STATUS, &status, sizeof(status));
		if (err != 0) {
			return err;
		}
		if ((status & 0x08u) == 0u) {
			break;
		}
	}

	err = twim_read(REG_PRESS_MSB, data, sizeof(data));
	if (err != 0) {
		return err;
	}

	adc_p = ((int32_t)data[0] << 12) | ((int32_t)data[1] << 4) | ((int32_t)data[2] >> 4);
	adc_t = ((int32_t)data[3] << 12) | ((int32_t)data[4] << 4) | ((int32_t)data[5] >> 4);
	adc_h = ((int32_t)data[6] << 8) | (int32_t)data[7];

	sample->temperature_centi_c = compensate_temperature(adc_t);
	sample->pressure_pa = compensate_pressure(adc_p);
	sample->humidity_centi_percent = compensate_humidity(adc_h);
	return 0;
}
```

## src/weather_bme280.h
```c
#ifndef TXING_WEATHER_BME280_H_
#define TXING_WEATHER_BME280_H_

#include <stdbool.h>
#include <stdint.h>

struct weather_bme280_sample {
	int32_t temperature_centi_c;
	uint32_t pressure_pa;
	uint16_t humidity_centi_percent;
};

int weather_bme280_init(void);
void weather_bme280_reset(void);
bool weather_bme280_ready(void);
int weather_bme280_sample(struct weather_bme280_sample *sample);

#endif
```

## src/weather_protocol.c
```c
#include "weather_protocol.h"

static void put_u16_le(uint8_t *out, uint16_t value)
{
	out[0] = (uint8_t)(value & 0xffu);
	out[1] = (uint8_t)(value >> 8);
}

static void put_u32_le(uint8_t *out, uint32_t value)
{
	out[0] = (uint8_t)(value & 0xffu);
	out[1] = (uint8_t)((value >> 8) & 0xffu);
	out[2] = (uint8_t)((value >> 16) & 0xffu);
	out[3] = (uint8_t)((value >> 24) & 0xffu);
}

bool weather_decode_command(const uint8_t *data, size_t len, uint8_t *target_redcon)
{
	uint8_t redcon;

	if (data == NULL || target_redcon == NULL || len < WEATHER_COMMAND_PAYLOAD_SIZE) {
		return false;
	}
	if (data[0] != WEATHER_PROTOCOL_VERSION) {
		return false;
	}

	redcon = data[1];
	if (redcon == 1u || redcon == 2u) {
		redcon = WEATHER_REDCON_ACTIVE;
	}
	if (redcon != WEATHER_REDCON_ACTIVE && redcon != WEATHER_REDCON_IDLE) {
		return false;
	}

	*target_redcon = redcon;
	return true;
}

void weather_encode_state(const struct weather_state *state,
			  uint8_t out[WEATHER_STATE_PAYLOAD_SIZE])
{
	uint8_t flags = 0u;

	if (state->redcon < WEATHER_REDCON_IDLE) {
		flags |= WEATHER_STATE_FLAG_ACTIVE;
	}
	if (state->bme280_valid) {
		flags |= WEATHER_STATE_FLAG_BME280_VALID;
	}

	out[0] = WEATHER_PROTOCOL_VERSION;
	out[1] = state->redcon;
	out[2] = flags;
	put_u16_le(&out[3], state->battery_mv);
}

void weather_encode_measurement(const struct weather_measurement *measurement,
				uint8_t out[WEATHER_MEASUREMENT_PAYLOAD_SIZE])
{
	out[0] = WEATHER_PROTOCOL_VERSION;
	put_u32_le(&out[1], (uint32_t)measurement->temperature_centi_c);
	put_u32_le(&out[5], measurement->pressure_pa);
	put_u16_le(&out[9], measurement->humidity_centi_percent);
	put_u16_le(&out[11], measurement->battery_mv);
}
```

## src/weather_protocol.h
```c
#ifndef TXING_WEATHER_PROTOCOL_H_
#define TXING_WEATHER_PROTOCOL_H_

#include <stdbool.h>
#include <stddef.h>
#include <stdint.h>

#define WEATHER_PROTOCOL_VERSION 1u
#define WEATHER_REDCON_ACTIVE 3u
#define WEATHER_REDCON_IDLE 4u

#define WEATHER_COMMAND_PAYLOAD_SIZE 2u
#define WEATHER_STATE_PAYLOAD_SIZE 5u
#define WEATHER_MEASUREMENT_PAYLOAD_SIZE 13u

#define WEATHER_STATE_FLAG_ACTIVE 0x01u
#define WEATHER_STATE_FLAG_BME280_VALID 0x02u

struct weather_state {
	uint8_t redcon;
	bool bme280_valid;
	uint16_t battery_mv;
};

struct weather_measurement {
	int32_t temperature_centi_c;
	uint32_t pressure_pa;
	uint16_t humidity_centi_percent;
	uint16_t battery_mv;
};

bool weather_decode_command(const uint8_t *data, size_t len, uint8_t *target_redcon);
void weather_encode_state(const struct weather_state *state,
			  uint8_t out[WEATHER_STATE_PAYLOAD_SIZE]);
void weather_encode_measurement(const struct weather_measurement *measurement,
				uint8_t out[WEATHER_MEASUREMENT_PAYLOAD_SIZE]);

#endif
```
